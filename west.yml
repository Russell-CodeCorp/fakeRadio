## west.yml
```yaml
manifest:

  projects:
    - name: shared
      url: git@github.com:Russell-CodeCorp/fakeShared.git
      # path-prefix: shared

    - name: zephyr-radio
      revision: v3.7.99-ncs3-branch
      url: git@github.com:nrfconnect/sdk-zephyr.git
      import:
        file: west.yml
        path-prefix: radio/deps
        name-allowlist:
          - hal_nordic
          - mcuboot
          - segger
```
